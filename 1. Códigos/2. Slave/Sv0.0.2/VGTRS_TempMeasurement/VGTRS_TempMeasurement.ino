// #########################################################
// VGTRS - ARDUINO TEMPERATURE MEASUREMENT
// By: VGROW Company
// Responsable Engineer: Leandro Souza
// #########################################################
// Bibliotecas
// -------------------------------------------------------
#include <max6675.h>  // Chip Termopar
#include <Wire.h>     // Protocolo I2C

// -------------------------------------------------------
// Pinos SPI
// -------------------------------------------------------
int _dataSO = 12;
int _dataSCK = 13;

// -------------------------------------------------------
// Pinos CS
// -------------------------------------------------------
int _D1 = 2;
int _D2 = 3;
int _D3 = 4;
int _D4 = 5;
int _D5 = 6;

// -------------------------------------------------------
// Valores antigos de temperatura
// -------------------------------------------------------
int _oldT1 = 0;
int _oldT2 = 0;
int _oldT3 = 0;
int _oldT4 = 0;
int _oldT5 = 0;

// -------------------------------------------------------
// Valor para reset
// -------------------------------------------------------
float _toReset = 0.5;

// -------------------------------------------------------
// Variáveis
// -------------------------------------------------------
int _sensorDelay = 1000;      // Tempo de estabilização do termopar
int _measurementDelay = 5000;  // Tempo entre leituras de temperatura
String _dataInside = "";      // String dentro do programa
String _dataOut = "";         // String para envio de dados
char _characterToFill = 'X';  // Caractere para preencher strings por completo

// -------------------------------------------------------
// Definição do sensor
// -------------------------------------------------------
MAX6675 _sensorT1(_dataSCK, _D1, _dataSO);
MAX6675 _sensorT2(_dataSCK, _D2, _dataSO);
MAX6675 _sensorT3(_dataSCK, _D3, _dataSO);
MAX6675 _sensorT4(_dataSCK, _D4, _dataSO);
MAX6675 _sensorT5(_dataSCK, _D5, _dataSO);

// #########################################################
// Função para reiniciar o arduino
// #########################################################
void (* resetFunc) (void) = 0;

// #########################################################
// Função de configuração
// #########################################################
void setup() { 
  // -------------------------------------------------------
  // Inicia protocolo I2C
  // -------------------------------------------------------
  Wire.begin(8);

  // -------------------------------------------------------
  // Evento de envio de dados via I2C
  // -------------------------------------------------------
  Wire.onRequest(requestData);

  // -------------------------------------------------------
  // Evento de recevimento de dados via I2C
  // -------------------------------------------------------
  Wire.onReceive(receiveData);

  // -------------------------------------------------------
  // Preenche a string com dados zerado
  // -------------------------------------------------------
  _dataOut = "000;000;000;000;000";

  // -------------------------------------------------------
  // Delay para estabilizar o termopar
  // -------------------------------------------------------
  delay(_sensorDelay);

  // -------------------------------------------------------
  // Atualiza os valores de temperaratura
  // -------------------------------------------------------
  _oldT1 = _sensorT1.readCelsius();
  _oldT2 = _sensorT2.readCelsius();
  _oldT3 = _sensorT3.readCelsius();
  _oldT4 = _sensorT4.readCelsius();
  _oldT5 = _sensorT5.readCelsius();
}

// #########################################################
// Função de repetição
// #########################################################
void loop() {
  // -------------------------------------------------------
  // Zera a string de dados interna do programa;
  // -------------------------------------------------------
  _dataInside = "";

  // -------------------------------------------------------
  // Leitura dos sensores
  // -------------------------------------------------------
  // Sensor T1
  // -------------------------------------------------------
  int T1 = _sensorT1.readCelsius();
  if (T1 >= _toReset * _oldT1){
    resetFunc();
  } else {
    _oldT1 = T1;
  }
  
  // -------------------------------------------------------
  // Sensor T2
  // -------------------------------------------------------
  int T2 = _sensorT2.readCelsius();
  if (T2 >= _toReset * _oldT2){
    resetFunc();
  } else {
    _oldT2 = T2;
  }
  
  // -------------------------------------------------------
  // Sensor T3
  // -------------------------------------------------------
  int T3 = _sensorT3.readCelsius();
  if (T3 >= _toReset * _oldT3){
    resetFunc();
  } else {
    _oldT3 = T3;
  }
  
  // -------------------------------------------------------
  // Sensor T4
  // -------------------------------------------------------
  int T4 = _sensorT4.readCelsius();
  if (T4 >= _toReset * _oldT4){
    resetFunc();
  } else {
    _oldT4 = T4;
  }
  
  // -------------------------------------------------------
  // Sensor T5
  // -------------------------------------------------------
  int T5 = _sensorT5.readCelsius();
  if (T5 >= _toReset * _oldT5){
    resetFunc();
  } else {
    _oldT5 = T5;
  }

  // -------------------------------------------------------
  // -------------------------------------------------------
  // Salva os dados obtidos na string
  // -------------------------------------------------------
  _dataInside = String(T1) + ";" + String(T2) + ";" + String(T3) + ";" + String(T4) + ";" + String(T5);

  // -------------------------------------------------------
  // Preenche a string com dados de envio
  // -------------------------------------------------------
  int count = 21 - _dataInside.length();
  for (int i = 0; i < count; i++){
    _dataInside += _characterToFill;
  }
  
  // -------------------------------------------------------
  // Salva a string lida na string de envio
  // -------------------------------------------------------
  _dataOut = _dataInside;

  // -------------------------------------------------------
  // Aplica o delay
  // -------------------------------------------------------
  delay(_measurementDelay);
}

// #########################################################
// Função de envio de dados
// #########################################################
void requestData(){
  // -------------------------------------------------------
  // Cria um array de buffer
  // -------------------------------------------------------
  char buffer[_dataOut.length()];

  // -------------------------------------------------------
  // Converte a string para o array
  // -------------------------------------------------------
  _dataOut.toCharArray(buffer, _dataOut.length());
  
  // -------------------------------------------------------
  // Envia os dados por I2C
  // -------------------------------------------------------
  Wire.write(buffer);
}

// #########################################################
// Função de recevimento de dados0
// #########################################################
void receiveData(){
  // -------------------------------------------------------
  // Reseta se receber pedido de reset
  // -------------------------------------------------------
  char c = Wire.read();
  if (c == 'R'){
    resetFunc();
  }
}

// #########################################################
// #########################################################
// #########################################################
